## config/boards/shields/dactyl_6x7/Kconfig.defconfig
```kconfig
if SHIELD_DACTYL_6x7_LEFT

    config ZMK_KEYBOARD_NAME
        default "LICHISCHE_DACTYL-L"

    config ZMK_SPLIT_BLE_ROLE_CENTRAL
        default y

endif

if SHIELD_DACTYL_6x7_RIGHT

    config ZMK_KEYBOARD_NAME
        default "LICHISCHE-DACTYL-R"

endif

if SHIELD_DACTYL_6x7_LEFT || SHIELD_DACTYL_6x7_RIGHT

    config ZMK_SPLIT
        default y

endif
```

## config/boards/shields/dactylccplus_6x7/Kconfig.shield
```kconfig
config SHIELD_DACTYL_MANUFORM_6x7_LEFT
    def_bool $(shields_list_contains,dactylccplus_6x7_left)

config SHIELD_DACTYL_MANUFORM_6x7_RIGHT
    def_bool $(shields_list_contains,dactylccplus_6x7_right)
```

## config_botched/boards/shields/dactyl_6x7/Kconfig.shield
```kconfig
config SHIELD_DACTYL_6x7_LEFT
    def_bool $(shields_list_contains,dactyl_6x7_left)

config SHIELD_DACTYL_6x7_RIGHT
    def_bool $(shields_list_contains,dactyl_6x7_right)
```
