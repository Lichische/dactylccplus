#include "dactyl_6x7.dtsi" // Notice that the main dtsi files are included in the overlay.
//тут указывается число вертикальных рядов, их 7

&kscan0 {
    col-gpios
        = <&pro_micro 29 GPIO_ACTIVE_HIGH> 	//прописал тут номера пинов из рапиновки найснано, вертикальные колонки
        , <&pro_micro 02 GPIO_ACTIVE_HIGH>
        , <&pro_micro 15 GPIO_ACTIVE_HIGH>
        , <&pro_micro 13 GPIO_ACTIVE_HIGH>
        , <&pro_micro 11 GPIO_ACTIVE_HIGH>
        , <&pro_micro 10 GPIO_ACTIVE_HIGH>
	, <&pro_micro 09 GPIO_ACTIVE_HIGH>
        ;
};