#include <dt-bindings/zmk/matrix_transform.h>

/ {
    chosen {
        zmk,kscan = &kscan0;
        zmk,matrix_transform = &default_transform;
    };

    default_transform: keymap_transform_0 {
        compatible = "zmk,matrix-transform";
        columns = <1>; //удвоенное число электрических колонок
        rows = <1>; //единичное число электрических рядов, строк

        map = <RC(0,0)>;
    };

    kscan0: kscan {
        diode-direction = "row2col";
        

    };
};
